## main/Kconfig.projbuild
```kconfig
menu "Watt-Master configuration"
menu "Device information"
    config DEVICE_ID
        string "Device ID"
        default "Watt-Master"
        help
            ID of the device. Same as in the database.
        
        config AMOUNT_OF_RELAYS
            int "Amount of relays on the device"
            default 3
            help
                The amount of relays on the device that can be controlled.
endmenu
menu "WiFi configuration"
    choice ESP_WIFI_SAE_MODE
        prompt "WPA3 SAE mode selection"
        default ESP_WPA3_SAE_PWE_BOTH
        help
            Select mode for SAE as Hunt and Peck, H2E or both.
        config ESP_WPA3_SAE_PWE_HUNT_AND_PECK
            bool "HUNT AND PECK"
        config ESP_WPA3_SAE_PWE_HASH_TO_ELEMENT
            bool "H2E"
        config ESP_WPA3_SAE_PWE_BOTH
            bool "BOTH"
    endchoice

    config ESP_WIFI_PW_ID
        string "PASSWORD IDENTIFIER"
        depends on  ESP_WPA3_SAE_PWE_HASH_TO_ELEMENT|| ESP_WPA3_SAE_PWE_BOTH
        default ""
        help
            password identifier for SAE H2E

    config ESP_MAXIMUM_RETRY
        int "Maximum retry"
        default 5
        help
            Set the Maximum retry to avoid station reconnecting to the AP unlimited when the AP is really inexistent.

    choice ESP_WIFI_SCAN_AUTH_MODE_THRESHOLD
        prompt "WiFi Scan auth mode threshold"
        default ESP_WIFI_AUTH_WPA2_PSK
        help
            The weakest authmode to accept in the scan mode.
            This value defaults to ESP_WIFI_AUTH_WPA2_PSK incase password is present and ESP_WIFI_AUTH_OPEN is used.
            Please select ESP_WIFI_AUTH_WEP/ESP_WIFI_AUTH_WPA_PSK incase AP is operating in WEP/WPA mode.

        config ESP_WIFI_AUTH_OPEN
            bool "OPEN"
        config ESP_WIFI_AUTH_WEP
            bool "WEP"
        config ESP_WIFI_AUTH_WPA_PSK
            bool "WPA PSK"
        config ESP_WIFI_AUTH_WPA2_PSK
            bool "WPA2 PSK"
        config ESP_WIFI_AUTH_WPA_WPA2_PSK
            bool "WPA/WPA2 PSK"
        config ESP_WIFI_AUTH_WPA3_PSK
            bool "WPA3 PSK"
        config ESP_WIFI_AUTH_WPA2_WPA3_PSK
            bool "WPA2/WPA3 PSK"
        config ESP_WIFI_AUTH_WAPI_PSK
            bool "WAPI PSK"
    endchoice

    config ESP_WIFI_SSID
        string "WiFi SSID"
        default "myssid"
        help
            SSID (network name) for the example to connect to.

    config ESP_WIFI_PASSWORD
        string "WiFi Password"
        default "mypassword"
        help
            WiFi password (WPA or WPA2) for the example to use.
    config ESP_WIFI_CHANNEL
        int "WiFi Channel"
        range 1 13
        default 1
        help
            WiFi channel (network channel) for the example to use.

    config ESP_MAX_STA_CONN
        int "Maximal STA connections"
        default 4
        help
            Max number of the STA connects to AP.
endmenu 
menu "MQTT configuration"
    config MQTT_BROKER_ADDRESS
        string  "MQTT Broker address"
        default "test.mosquitto.org"
        help
            Address of the MQTT broker. For example, 'test.mosquitto.org'.

            
    config MQTT_BROKER_PORT
        string "MQTT Broker port"
        default "1883"
        help
            Port that the mqtt broker listens to. for example, '1883'.

    config MQTT_PASSWORD
        string "Password for MQTT"
        default "mypassword"
        help
            Unique password for the device that is configured to the access list of the MQTT broker. the MQTT username is the device ID.
        
    config MQTT_NEW_DEVICE_TOPIC
        string "Topic to send the device data after connection"
        default "device/new"
        help
            Topic to send the device data after connection. The data should be in a format "DEVICE_ID=[DEVICE_ID]".

    config MQTT_DEVICE_TOPIC_BASE
        string "Base topic for the device"
        default "device"
        help
            Base topic for the device. The device will publish data to this topic. Rest of the topic is handled in main.h, where the device ID is appended to the base topic (e.g. device/[DEVICE_ID]).
endmenu

menu "SSL Certificate downloader"
    config ENABLE_SSL_CERT_DOWNLOADER
        bool "Enable SSL certificate downloader (beta testing)"
        help
           If enabled, downloads the SSL certificate from the designated HTTP web server and overwrites the default certificate from spiffs. (Still in beta testing, use with caution.)

    config SSL_CERT_DOWNLOAD_URL
        string "SSL certificate download URL"
        depends on ENABLE_SSL_CERT_DOWNLOADER
        default "http://pve.mosquitto/certificate"
        help 
            URL to download the SSL certificate from. For example, "http://pve.mosquitto/certificate".   
endmenu
endmenu
```
